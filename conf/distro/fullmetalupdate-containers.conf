## conf/distro/fullmetalupdate-containers.conf
```bitbake
require conf/distro/poky.conf
require conf/distro/variables.conf

DISTRO = "fullmetalupdate-containers"
DISTRO_NAME = "FullMetalUpdate containers"
DISTRO_VERSION = "1.0"
DISTRO_CODENAME = ""
SDK_VENDOR = "-fullmetalupdate-containers-sdk"
SDK_VERSION := "${@'${DISTRO_VERSION}'.replace('snapshot-${DATE}','snapshot')}"

MAINTAINER = "Witekio <tgagneret@witekio.com>"

TARGET_VENDOR = "-fullmetalupdatecontainers"

LOCALCONF_VERSION = "1"

DISTRO_VERSION[vardepsexclude] = "DATE"
SDK_VERSION[vardepsexclude] = "DATE"

PREFERRED_PROVIDER_virtual/base-utils = "toybox"
VIRTUAL-RUNTIME_base-utils = "toybox"

MACHINE_FEATURES = ""
BAD_RECOMMENDATIONS += "busybox-syslog busybox-udhcpc"

DISTRO_FEATURES_remove = "x11 wayland"
DISTRO_FEATURES_append = " libpng opengl"

INHERIT += " fullmetalupdate_sota"
```

## conf/distro/fullmetalupdate-os.conf
```bitbake
require conf/distro/poky.conf
require conf/distro/variables.conf
require conf/distro/sota.conf.inc

DISTRO = "fullmetalupdate-os"
DISTRO_NAME = "FullMetalUpdate OS"
DISTRO_VERSION = "1.0"
DISTRO_CODENAME = ""
SDK_VENDOR = "-fullmetalupdate-sdk"
SDK_VERSION := "${@'${DISTRO_VERSION}'.replace('snapshot-${DATE}','snapshot')}"

MAINTAINER = "Witekio <tgagneret@witekio.com>"

TARGET_VENDOR = "-fullmetalupdate"

LOCALCONF_VERSION = "1"

DISTRO_VERSION[vardepsexclude] = "DATE"
SDK_VERSION[vardepsexclude] = "DATE"

DISTRO_FEATURES_append = " virtualization systemd sota usrmerge"
VIRTUAL-RUNTIME_init_manager = "systemd"
DISTRO_FEATURES_remove = "sysvinit"
DISTRO_FEATURES_remove = "x11"
DISTRO_FEATURES_remove = "${@bb.utils.contains_any('MACHINE', ['imx8mqevk'], '', 'wayland', d)}"

PREFERRED_PROVIDER_virtual/runc = "runc-opencontainers"

INHERIT += " fullmetalupdate_sota"
```

## conf/distro/variables.conf
```bitbake
APP_DIRECTORY="/apps"
PRODUCT_ID = "${MACHINE}"
CONTAINERS_DIRECTORY = "${TOPDIR}/tmp/fullmetalupdate-containers/deploy/containers/${MACHINE}"
```

## conf/layer.conf
```bitbake
# We have a conf and classes directory, add to BBPATH
BBPATH .= ":${LAYERDIR}"

# We have recipes-* directories, add to BBFILES
BBFILES += "${LAYERDIR}/recipes-*/*/*.bb \
	${LAYERDIR}/recipes-*/*/*.bbappend"

BBFILE_COLLECTIONS += "fullmetalupdate"
BBFILE_PATTERN_fullmetalupdate = "^${LAYERDIR}/"
BBFILE_PRIORITY_fullmetalupdate = "91"

BBFILES += "${@' '.join('${LAYERDIR}/%s/recipes*/*/*.%s' % (layer, ext) \
               for layer in '${BBFILE_COLLECTIONS}'.split() for ext in ['bb', 'bbappend'])}"

BBFILES_DYNAMIC += " \
    qt5-layer:${LAYERDIR}/dynamic-layers/qt5-layer/*/*/*.bb \
    qt5-layer:${LAYERDIR}/dynamic-layers/qt5-layer/*/*/*.bbappend \
"
```
